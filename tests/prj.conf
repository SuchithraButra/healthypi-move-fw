## CMakeLists.txt
```
cmake_minimum_required(VERSION 3.20.0)

find_package(Zephyr REQUIRED HINTS $ENV{ZEPHYR_BASE})
project(smf_display_tests)

# Add test source files
target_sources(app PRIVATE 
    src/main.c
    # Core test is included via main.c to avoid duplicate definitions
)

# Add mock include directories  
target_include_directories(app PRIVATE 
    src
    src/mocks
    ../app/src
    ../app/src/sm
)

# Add compile definitions for testing
target_compile_definitions(app PRIVATE
    CONFIG_ZTEST=1
)
```

## prj.conf
```kconfig
CONFIG_ZTEST=y
CONFIG_ZTEST_NEW_API=y
CONFIG_SMF=y
CONFIG_DISPLAY=y
CONFIG_ZBUS=y
CONFIG_LOG=y
CONFIG_HEAP_MEM_POOL_SIZE=16384
CONFIG_MAIN_STACK_SIZE=4096
CONFIG_ZTEST_STACKSIZE=4096
CONFIG_TEST_RANDOM_GENERATOR=y
CONFIG_ZTEST_ASSERT_VERBOSE=1
```

## src/main.c
```c
/*
 * Main test entry point for SMF Display Module Tests
 * Compatible with Zephyr Twister test framework
 */

#include <zephyr/ztest.h>

// Include the actual test implementation
#include "test_smf_display_core.c"

// Test main function - required by Twister
void test_main(void)
{
    ztest_run_test_suites(NULL);
}
```

## src/test_smf_display.c
```c
#include <zephyr/ztest.h>
#include <zephyr/kernel.h>
#include <zephyr/smf.h>
#include <zephyr/logging/log.h>
#include <time.h>
#include <string.h>

// Include mocks
#include "mock_hpi_common_types.h"
#include "mock_lvgl.h"
#include "mock_hw_module.h"
#include "mock_ui_move.h"
#include "mock_display_sh8601.h"
#include "mock_max32664_updater.h"
#include "mock_hpi_sys.h"

// We need to expose some internal functions and variables for testing
// This would normally be done via a test header or by making functions non-static

// Define test-specific versions of the constants and enums
#define HPI_DEFAULT_START_SCREEN SCR_SPO2
#define DISP_SLEEP_TIME_MS 10000

enum display_state
{
    HPI_DISPLAY_STATE_INIT,
    HPI_DISPLAY_STATE_SPLASH,
    HPI_DISPLAY_STATE_BOOT,
    HPI_DISPLAY_STATE_SCR_PROGRESS,
    HPI_DISPLAY_STATE_ACTIVE,
    HPI_DISPLAY_STATE_SLEEP,
    HPI_DISPLAY_STATE_ON,
    HPI_DISPLAY_STATE_OFF,
};

// Mock the global variables and objects that would be in the actual module
static struct s_disp_object {
    struct smf_ctx ctx;
    char title[100];
    char subtitle[100];
} s_disp_obj;

static int curr_screen = SCR_HOME;
static bool mock_low_battery = false;
static int mock_inactivity_time = 0;
static uint8_t mock_batt_level = 50;
static bool mock_batt_charging = false;

// Mock message queues
K_MSGQ_DEFINE(q_plot_ecg_bioz, sizeof(struct hpi_ecg_bioz_sensor_data_t), 64, 1);
K_MSGQ_DEFINE(q_plot_ppg_wrist, sizeof(struct hpi_ppg_wr_data_t), 64, 1);
K_MSGQ_DEFINE(q_plot_ppg_fi, sizeof(struct hpi_ppg_fi_data_t), 64, 1);
K_MSGQ_DEFINE(q_disp_boot_msg, sizeof(struct hpi_boot_msg_t), 4, 1);

// Mock semaphores
K_SEM_DEFINE(sem_disp_ready, 0, 1);
K_SEM_DEFINE(sem_ecg_complete, 0, 1);
K_SEM_DEFINE(sem_change_screen, 0, 1);
K_SEM_DEFINE(sem_crown_key_pressed, 0, 1);

// Mock mutexes
K_MUTEX_DEFINE(mutex_curr_screen);
K_MUTEX_DEFINE(mutex_screen_sleep_state);

// Screen state persistence structure
static struct {
    int saved_screen;
    enum scroll_dir saved_scroll_dir;
    uint32_t saved_arg1;
    uint32_t saved_arg2;
    uint32_t saved_arg3;
    uint32_t saved_arg4;
    bool state_saved;
} screen_sleep_state = {
    .saved_screen = SCR_HOME,
    .saved_scroll_dir = SCROLL_NONE,
    .saved_arg1 = 0,
    .saved_arg2 = 0,
    .saved_arg3 = 0,
    .saved_arg4 = 0,
    .state_saved = false
};

// Mock user profile settings
static uint16_t m_user_height = 170;
static uint16_t m_user_weight = 70;
static double m_user_met = 3.5;

// Function prototypes for functions under test
void hpi_disp_set_curr_screen(int screen);
int hpi_disp_get_curr_screen(void);
int hpi_disp_reset_all_last_updated(void);
static void hpi_disp_save_screen_state(void);
static void hpi_disp_restore_screen_state(void);
static void hpi_disp_clear_saved_state(void);
static uint16_t hpi_get_kcals_from_steps(uint16_t steps);

// Implementation of functions under test (simplified for testing)
void hpi_disp_set_curr_screen(int screen)
{
    k_mutex_lock(&mutex_curr_screen, K_FOREVER);
    curr_screen = screen;
    k_mutex_unlock(&mutex_curr_screen);
}

int hpi_disp_get_curr_screen(void)
{
    k_mutex_lock(&mutex_curr_screen, K_FOREVER);
    int screen = curr_screen;
    k_mutex_unlock(&mutex_curr_screen);
    return screen;
}

int hpi_disp_reset_all_last_updated(void)
{
    // Reset all display variables to 0
    return 0; // Success
}

static void hpi_disp_save_screen_state(void)
{
    k_mutex_lock(&mutex_screen_sleep_state, K_FOREVER);
    
    screen_sleep_state.saved_screen = hpi_disp_get_curr_screen();
    screen_sleep_state.saved_scroll_dir = SCROLL_NONE; // Mock value
    screen_sleep_state.saved_arg1 = 0;
    screen_sleep_state.saved_arg2 = 0;
    screen_sleep_state.saved_arg3 = 0;
    screen_sleep_state.saved_arg4 = 0;
    screen_sleep_state.state_saved = true;
    
    k_mutex_unlock(&mutex_screen_sleep_state);
}

static void hpi_disp_restore_screen_state(void)
{
    k_mutex_lock(&mutex_screen_sleep_state, K_FOREVER);
    
    if (screen_sleep_state.state_saved) {
        int saved_screen = screen_sleep_state.saved_screen;
        k_mutex_unlock(&mutex_screen_sleep_state);
        
        // Mock screen loading
        hpi_disp_set_curr_screen(saved_screen);
    } else {
        k_mutex_unlock(&mutex_screen_sleep_state);
        // Load current screen
    }
}

static void hpi_disp_clear_saved_state(void)
{
    k_mutex_lock(&mutex_screen_sleep_state, K_FOREVER);
    
    screen_sleep_state.state_saved = false;
    screen_sleep_state.saved_screen = SCR_HOME;
    screen_sleep_state.saved_scroll_dir = SCROLL_NONE;
    screen_sleep_state.saved_arg1 = 0;
    screen_sleep_state.saved_arg2 = 0;
    screen_sleep_state.saved_arg3 = 0;
    screen_sleep_state.saved_arg4 = 0;
    
    k_mutex_unlock(&mutex_screen_sleep_state);
}

static uint16_t hpi_get_kcals_from_steps(uint16_t steps)
{
    double _m_time = (((m_user_height / 100.000) * 0.414 * steps) / 4800.000) * 60.000;
    double _m_kcals = (_m_time * m_user_met * 3.500 * m_user_weight) / 200;
    return (uint16_t)_m_kcals;
}

// Mock state machine functions
static void st_display_init_entry(void *o) { /* Mock implementation */ }
static void st_display_splash_entry(void *o) { /* Mock implementation */ }
static void st_display_splash_run(void *o) { /* Mock implementation */ }
static void st_display_boot_entry(void *o) { /* Mock implementation */ }
static void st_display_boot_run(void *o) { /* Mock implementation */ }
static void st_display_boot_exit(void *o) { /* Mock implementation */ }
static void st_display_active_entry(void *o) { /* Mock implementation */ }
static void st_display_active_run(void *o) { /* Mock implementation */ }
static void st_display_active_exit(void *o) { /* Mock implementation */ }
static void st_display_sleep_entry(void *o) { /* Mock implementation */ }
static void st_display_sleep_run(void *o) { /* Mock implementation */ }
static void st_display_sleep_exit(void *o) { /* Mock implementation */ }
static void st_display_on_entry(void *o) { /* Mock implementation */ }

// Mock state machine definition
static const struct smf_state display_states[] = {
    [HPI_DISPLAY_STATE_INIT] = SMF_CREATE_STATE(st_display_init_entry, NULL, NULL, NULL, NULL),
    [HPI_DISPLAY_STATE_SPLASH] = SMF_CREATE_STATE(st_display_splash_entry, st_display_splash_run, NULL, NULL, NULL),
    [HPI_DISPLAY_STATE_BOOT] = SMF_CREATE_STATE(st_display_boot_entry, st_display_boot_run, st_display_boot_exit, NULL, NULL),
    [HPI_DISPLAY_STATE_ACTIVE] = SMF_CREATE_STATE(st_display_active_entry, st_display_active_run, st_display_active_exit, NULL, NULL),
    [HPI_DISPLAY_STATE_SLEEP] = SMF_CREATE_STATE(st_display_sleep_entry, st_display_sleep_run, st_display_sleep_exit, NULL, NULL),
    [HPI_DISPLAY_STATE_ON] = SMF_CREATE_STATE(st_display_on_entry, NULL, NULL, NULL, NULL),
};

/* Test suite setup and teardown */
static void *smf_display_setup(void)
{
    // Initialize test environment
    curr_screen = SCR_HOME;
    mock_low_battery = false;
    mock_inactivity_time = 0;
    mock_batt_level = 50;
    mock_batt_charging = false;
    
    // Clear screen sleep state
    hpi_disp_clear_saved_state();
    
    return NULL;
}

static void smf_display_teardown(void *fixture)
{
    // Clean up test environment
    hpi_disp_clear_saved_state();
    
    // Clear message queues
    struct hpi_ecg_bioz_sensor_data_t dummy_ecg;
    struct hpi_ppg_wr_data_t dummy_ppg_wr;
    struct hpi_ppg_fi_data_t dummy_ppg_fi;
    struct hpi_boot_msg_t dummy_boot;
    
    while (k_msgq_get(&q_plot_ecg_bioz, &dummy_ecg, K_NO_WAIT) == 0) { }
    while (k_msgq_get(&q_plot_ppg_wrist, &dummy_ppg_wr, K_NO_WAIT) == 0) { }
    while (k_msgq_get(&q_plot_ppg_fi, &dummy_ppg_fi, K_NO_WAIT) == 0) { }
    while (k_msgq_get(&q_disp_boot_msg, &dummy_boot, K_NO_WAIT) == 0) { }
}

/* Test cases for screen management functions */
ZTEST(smf_display, test_hpi_disp_set_get_curr_screen)
{
    // Test setting and getting current screen
    hpi_disp_set_curr_screen(SCR_HR);
    zassert_equal(hpi_disp_get_curr_screen(), SCR_HR, "Screen should be set to SCR_HR");
    
    hpi_disp_set_curr_screen(SCR_SPO2);
    zassert_equal(hpi_disp_get_curr_screen(), SCR_SPO2, "Screen should be set to SCR_SPO2");
    
    hpi_disp_set_curr_screen(SCR_HOME);
    zassert_equal(hpi_disp_get_curr_screen(), SCR_HOME, "Screen should be set to SCR_HOME");
}

ZTEST(smf_display, test_hpi_disp_reset_all_last_updated)
{
    // Test resetting all last updated values
    int result = hpi_disp_reset_all_last_updated();
    zassert_equal(result, 0, "Reset function should return success");
}

/* Test cases for screen state persistence */
ZTEST(smf_display, test_screen_state_save_restore)
{
    // Set a specific screen
    hpi_disp_set_curr_screen(SCR_HR);
    
    // Save the screen state
    hpi_disp_save_screen_state();
    
    // Verify the state was saved
    zassert_true(screen_sleep_state.state_saved, "Screen state should be saved");
    zassert_equal(screen_sleep_state.saved_screen, SCR_HR, "Saved screen should be SCR_HR");
    
    // Change the current screen
    hpi_disp_set_curr_screen(SCR_SPO2);
    zassert_equal(hpi_disp_get_curr_screen(), SCR_SPO2, "Current screen should be SCR_SPO2");
    
    // Restore the screen state
    hpi_disp_restore_screen_state();
    zassert_equal(hpi_disp_get_curr_screen(), SCR_HR, "Screen should be restored to SCR_HR");
}

ZTEST(smf_display, test_screen_state_clear)
{
    // Save a screen state
    hpi_disp_set_curr_screen(SCR_TEMP);
    hpi_disp_save_screen_state();
    zassert_true(screen_sleep_state.state_saved, "Screen state should be saved");
    
    // Clear the saved state
    hpi_disp_clear_saved_state();
    zassert_false(screen_sleep_state.state_saved, "Screen state should be cleared");
    zassert_equal(screen_sleep_state.saved_screen, SCR_HOME, "Saved screen should reset to SCR_HOME");
}

ZTEST(smf_display, test_screen_state_restore_no_saved_state)
{
    // Clear any saved state
    hpi_disp_clear_saved_state();
    
    // Set current screen
    hpi_disp_set_curr_screen(SCR_BPT);
    
    // Try to restore with no saved state
    hpi_disp_restore_screen_state();
    
    // Current screen should remain unchanged
    zassert_equal(hpi_disp_get_curr_screen(), SCR_BPT, "Screen should remain unchanged");
}

/* Test cases for calorie calculation */
ZTEST(smf_display, test_hpi_get_kcals_from_steps_zero_steps)
{
    uint16_t kcals = hpi_get_kcals_from_steps(0);
    zassert_equal(kcals, 0, "Zero steps should result in zero calories");
}

ZTEST(smf_display, test_hpi_get_kcals_from_steps_normal_values)
{
    uint16_t kcals = hpi_get_kcals_from_steps(1000);
    zassert_true(kcals > 0, "1000 steps should result in some calories");
    zassert_true(kcals < 100, "1000 steps should result in reasonable calorie count");
}

ZTEST(smf_display, test_hpi_get_kcals_from_steps_large_values)
{
    uint16_t kcals = hpi_get_kcals_from_steps(10000);
    zassert_true(kcals > 0, "10000 steps should result in some calories");
    
    // Verify that more steps result in more calories
    uint16_t kcals_small = hpi_get_kcals_from_steps(1000);
    zassert_true(kcals > kcals_small, "More steps should result in more calories");
}

/* Test cases for message queue handling */
ZTEST(smf_display, test_message_queue_ecg_bioz)
{
    struct hpi_ecg_bioz_sensor_data_t test_data = {
        .ecg_samples = {100, 101, 102},
        .ecg_num_samples = 3,
        .ecg_lead_off = false
    };
    
    // Put data in queue
    int ret = k_msgq_put(&q_plot_ecg_bioz, &test_data, K_NO_WAIT);
    zassert_equal(ret, 0, "Should be able to put data in ECG queue");
    
    // Get data from queue
    struct hpi_ecg_bioz_sensor_data_t received_data;
    ret = k_msgq_get(&q_plot_ecg_bioz, &received_data, K_NO_WAIT);
    zassert_equal(ret, 0, "Should be able to get data from ECG queue");
    
    // Verify data integrity
    zassert_equal(received_data.ecg_num_samples, 3, "ECG sample count should match");
    zassert_false(received_data.ecg_lead_off, "ECG lead off should match");
}

ZTEST(smf_display, test_message_queue_ppg_wrist)
{
    struct hpi_ppg_wr_data_t test_data = {
        .hr = 75,
        .spo2 = 98,
        .spo2_state = 1,
        .spo2_valid_percent_complete = 85
    };
    
    // Put data in queue
    int ret = k_msgq_put(&q_plot_ppg_wrist, &test_data, K_NO_WAIT);
    zassert_equal(ret, 0, "Should be able to put data in PPG wrist queue");
    
    // Get data from queue
    struct hpi_ppg_wr_data_t received_data;
    ret = k_msgq_get(&q_plot_ppg_wrist, &received_data, K_NO_WAIT);
    zassert_equal(ret, 0, "Should be able to get data from PPG wrist queue");
    
    // Verify data integrity
    zassert_equal(received_data.hr, 75, "HR should match");
    zassert_equal(received_data.spo2, 98, "SpO2 should match");
}

ZTEST(smf_display, test_message_queue_boot_msg)
{
    struct hpi_boot_msg_t test_msg = {
        .status = true,
        .show_status = true
    };
    strncpy(test_msg.msg, "Test Boot Message", sizeof(test_msg.msg) - 1);
    
    // Put message in queue
    int ret = k_msgq_put(&q_disp_boot_msg, &test_msg, K_NO_WAIT);
    zassert_equal(ret, 0, "Should be able to put boot message in queue");
    
    // Get message from queue
    struct hpi_boot_msg_t received_msg;
    ret = k_msgq_get(&q_disp_boot_msg, &received_msg, K_NO_WAIT);
    zassert_equal(ret, 0, "Should be able to get boot message from queue");
    
    // Verify message integrity
    zassert_true(received_msg.status, "Boot status should be true");
    zassert_true(received_msg.show_status, "Show status should be true");
    zassert_equal(strcmp(received_msg.msg, "Test Boot Message"), 0, "Boot message should match");
}

/* Test cases for semaphore operations */
ZTEST(smf_display, test_semaphore_operations)
{
    // Test display ready semaphore
    zassert_equal(k_sem_take(&sem_disp_ready, K_NO_WAIT), -EBUSY, "Semaphore should not be available initially");
    
    k_sem_give(&sem_disp_ready);
    zassert_equal(k_sem_take(&sem_disp_ready, K_NO_WAIT), 0, "Semaphore should be available after give");
    
    // Test ECG complete semaphore
    zassert_equal(k_sem_take(&sem_ecg_complete, K_NO_WAIT), -EBUSY, "ECG semaphore should not be available initially");
    
    k_sem_give(&sem_ecg_complete);
    zassert_equal(k_sem_take(&sem_ecg_complete, K_NO_WAIT), 0, "ECG semaphore should be available after give");
}

/* Test cases for state machine initialization */
ZTEST(smf_display, test_state_machine_structure)
{
    // Verify that all required states are defined
    zassert_not_null(display_states[HPI_DISPLAY_STATE_INIT].entry, "INIT state should have entry function");
    zassert_not_null(display_states[HPI_DISPLAY_STATE_SPLASH].entry, "SPLASH state should have entry function");
    zassert_not_null(display_states[HPI_DISPLAY_STATE_BOOT].entry, "BOOT state should have entry function");
    zassert_not_null(display_states[HPI_DISPLAY_STATE_ACTIVE].entry, "ACTIVE state should have entry function");
    zassert_not_null(display_states[HPI_DISPLAY_STATE_SLEEP].entry, "SLEEP state should have entry function");
}

ZTEST(smf_display, test_state_machine_context_initialization)
{
    // Initialize SMF context
    smf_set_initial(SMF_CTX(&s_disp_obj), &display_states[HPI_DISPLAY_STATE_INIT]);
    
    // Verify context is properly initialized
    zassert_not_null(SMF_CTX(&s_disp_obj), "SMF context should be initialized");
}

/* Test cases for thread safety */
ZTEST(smf_display, test_mutex_protection_curr_screen)
{
    // This test verifies that the mutex protects access to curr_screen
    // In a real test environment, this would involve multiple threads
    
    hpi_disp_set_curr_screen(SCR_HR);
    int screen1 = hpi_disp_get_curr_screen();
    
    hpi_disp_set_curr_screen(SCR_SPO2);
    int screen2 = hpi_disp_get_curr_screen();
    
    zassert_equal(screen1, SCR_HR, "First screen read should be HR");
    zassert_equal(screen2, SCR_SPO2, "Second screen read should be SPO2");
    zassert_not_equal(screen1, screen2, "Screen values should be different");
}

/* Test suite definition */
ZTEST_SUITE(smf_display, NULL, smf_display_setup, NULL, NULL, smf_display_teardown);
```

## src/test_smf_display_core.c
```c
/*
 * Standalone Test Suite for SMF Display Module Core Functions
 * 
 * This test suite validates the core display functionality without
 * requiring full Zephyr SMF integration.
 */

#include <zephyr/ztest.h>
#include <string.h>
#include <time.h>
#include <math.h>

// Mock includes
#include "mock_hpi_common_types.h"

// Test-specific constants
#define DISP_SLEEP_TIME_MS 10000
#define HPI_DEFAULT_START_SCREEN SCR_SPO2

// Global test variables
static int curr_screen = SCR_HOME;
static bool mock_low_battery = false;
static int mock_inactivity_time = 0;

// Simple mutex implementation for testing
struct test_mutex {
    int locked;
};

static int test_mutex_lock(struct test_mutex *mutex) {
    if (mutex->locked) {
        return -1; // Would block in real implementation
    }
    mutex->locked = 1;
    return 0;
}

static int test_mutex_unlock(struct test_mutex *mutex) {
    mutex->locked = 0;
    return 0;
}

// Test mutexes
static struct test_mutex mutex_curr_screen = {0};
static struct test_mutex mutex_screen_sleep_state = {0};

// Screen state persistence structure
static struct {
    int saved_screen;
    enum scroll_dir saved_scroll_dir;
    uint32_t saved_arg1;
    uint32_t saved_arg2;
    uint32_t saved_arg3;
    uint32_t saved_arg4;
    bool state_saved;
} screen_sleep_state = {
    .saved_screen = SCR_HOME,
    .saved_scroll_dir = SCROLL_NONE,
    .saved_arg1 = 0,
    .saved_arg2 = 0,
    .saved_arg3 = 0,
    .saved_arg4 = 0,
    .state_saved = false
};

// User profile settings for calorie calculation
static uint16_t m_user_height = 170; // cm
static uint16_t m_user_weight = 70;  // kg
static double m_user_met = 3.5;      // MET value

// Message queue implementation for testing
#define MSGQ_MAX_MSGS 64

struct test_msgq {
    void *buffer;
    size_t msg_size;
    size_t max_msgs;
    size_t count;
    size_t head;
    size_t tail;
};

static int test_msgq_put(struct test_msgq *msgq, const void *data)
{
    if (msgq->count >= msgq->max_msgs) {
        return -1; // Queue full
    }
    
    char *buffer = (char *)msgq->buffer;
    size_t offset = (msgq->tail * msgq->msg_size);
    memcpy(&buffer[offset], data, msgq->msg_size);
    
    msgq->tail = (msgq->tail + 1) % msgq->max_msgs;
    msgq->count++;
    
    return 0;
}

static int test_msgq_get(struct test_msgq *msgq, void *data)
{
    if (msgq->count == 0) {
        return -1; // Queue empty
    }
    
    char *buffer = (char *)msgq->buffer;
    size_t offset = (msgq->head * msgq->msg_size);
    memcpy(data, &buffer[offset], msgq->msg_size);
    
    msgq->head = (msgq->head + 1) % msgq->max_msgs;
    msgq->count--;
    
    return 0;
}

static void test_msgq_reset(struct test_msgq *msgq)
{
    msgq->count = 0;
    msgq->head = 0;
    msgq->tail = 0;
}

// Test message queue buffers
static char ecg_buffer[MSGQ_MAX_MSGS * sizeof(struct hpi_ecg_bioz_sensor_data_t)];
static char ppg_wr_buffer[MSGQ_MAX_MSGS * sizeof(struct hpi_ppg_wr_data_t)];
static char ppg_fi_buffer[MSGQ_MAX_MSGS * sizeof(struct hpi_ppg_fi_data_t)];
static char boot_msg_buffer[4 * sizeof(struct hpi_boot_msg_t)];

static struct test_msgq q_plot_ecg_bioz = {
    .buffer = ecg_buffer,
    .msg_size = sizeof(struct hpi_ecg_bioz_sensor_data_t),
    .max_msgs = MSGQ_MAX_MSGS,
    .count = 0, .head = 0, .tail = 0
};

static struct test_msgq q_plot_ppg_wrist = {
    .buffer = ppg_wr_buffer,
    .msg_size = sizeof(struct hpi_ppg_wr_data_t),
    .max_msgs = MSGQ_MAX_MSGS,
    .count = 0, .head = 0, .tail = 0
};

static struct test_msgq q_plot_ppg_fi = {
    .buffer = ppg_fi_buffer,
    .msg_size = sizeof(struct hpi_ppg_fi_data_t),
    .max_msgs = MSGQ_MAX_MSGS,
    .count = 0, .head = 0, .tail = 0
};

static struct test_msgq q_disp_boot_msg = {
    .buffer = boot_msg_buffer,
    .msg_size = sizeof(struct hpi_boot_msg_t),
    .max_msgs = 4,
    .count = 0, .head = 0, .tail = 0
};

/* Functions under test - extracted and simplified from smf_display.c */

void hpi_disp_set_curr_screen(int screen)
{
    test_mutex_lock(&mutex_curr_screen);
    curr_screen = screen;
    test_mutex_unlock(&mutex_curr_screen);
}

int hpi_disp_get_curr_screen(void)
{
    test_mutex_lock(&mutex_curr_screen);
    int screen = curr_screen;
    test_mutex_unlock(&mutex_curr_screen);
    return screen;
}

int hpi_disp_reset_all_last_updated(void)
{
    // In the real implementation, this resets all display variables
    // For testing, we just return success
    return 0;
}

static void hpi_disp_save_screen_state(void)
{
    test_mutex_lock(&mutex_screen_sleep_state);
    
    screen_sleep_state.saved_screen = hpi_disp_get_curr_screen();
    screen_sleep_state.saved_scroll_dir = SCROLL_NONE;
    screen_sleep_state.saved_arg1 = 0;
    screen_sleep_state.saved_arg2 = 0;
    screen_sleep_state.saved_arg3 = 0;
    screen_sleep_state.saved_arg4 = 0;
    screen_sleep_state.state_saved = true;
    
    test_mutex_unlock(&mutex_screen_sleep_state);
}

static void hpi_disp_restore_screen_state(void)
{
    test_mutex_lock(&mutex_screen_sleep_state);
    
    if (screen_sleep_state.state_saved) {
        int saved_screen = screen_sleep_state.saved_screen;
        test_mutex_unlock(&mutex_screen_sleep_state);
        
        // Restore the saved screen
        hpi_disp_set_curr_screen(saved_screen);
    } else {
        test_mutex_unlock(&mutex_screen_sleep_state);
        // No saved state - current screen remains unchanged
    }
}

static void hpi_disp_clear_saved_state(void)
{
    test_mutex_lock(&mutex_screen_sleep_state);
    
    screen_sleep_state.state_saved = false;
    screen_sleep_state.saved_screen = SCR_HOME;
    screen_sleep_state.saved_scroll_dir = SCROLL_NONE;
    screen_sleep_state.saved_arg1 = 0;
    screen_sleep_state.saved_arg2 = 0;
    screen_sleep_state.saved_arg3 = 0;
    screen_sleep_state.saved_arg4 = 0;
    
    test_mutex_unlock(&mutex_screen_sleep_state);
}

static uint16_t hpi_get_kcals_from_steps(uint16_t steps)
{
    // KCals = time * MET * 3.5 * weight / (200*60)
    // time = (height_m * 0.414 * steps) / speed_kmh * 60 (convert to minutes)
    // Assuming walking speed of 4.8 km/h
    
    if (steps == 0) {
        return 0;
    }
    
    double height_m = m_user_height / 100.0;
    double time_minutes = ((height_m * 0.414 * steps) / 4800.0) * 60.0;
    double kcals = (time_minutes * m_user_met * 3.5 * m_user_weight) / 200.0;
    
    return (uint16_t)kcals;
}

// Mock hardware functions
bool hw_is_low_battery(void)
{
    return mock_low_battery;
}

int lv_disp_get_inactive_time(void *disp)
{
    return mock_inactivity_time;
}

void lv_disp_trig_activity(void *disp)
{
    mock_inactivity_time = 0;
}

// Helper function to check sleep conditions
bool should_enter_sleep(void)
{
    return (lv_disp_get_inactive_time(NULL) > DISP_SLEEP_TIME_MS && !hw_is_low_battery());
}

/* Test suite setup and teardown */
static void *setup(void)
{
    curr_screen = SCR_HOME;
    mock_low_battery = false;
    mock_inactivity_time = 0;
    
    hpi_disp_clear_saved_state();
    
    test_msgq_reset(&q_plot_ecg_bioz);
    test_msgq_reset(&q_plot_ppg_wrist);
    test_msgq_reset(&q_plot_ppg_fi);
    test_msgq_reset(&q_disp_boot_msg);
    
    return NULL;
}

static void teardown(void *fixture)
{
    hpi_disp_clear_saved_state();
    
    test_msgq_reset(&q_plot_ecg_bioz);
    test_msgq_reset(&q_plot_ppg_wrist);
    test_msgq_reset(&q_plot_ppg_fi);
    test_msgq_reset(&q_disp_boot_msg);
}

/* Test cases */

ZTEST(smf_display_core, test_screen_management_basic)
{
    // Test basic screen setting and getting
    hpi_disp_set_curr_screen(SCR_HR);
    zassert_equal(hpi_disp_get_curr_screen(), SCR_HR, "Should set and get HR screen");
    
    hpi_disp_set_curr_screen(SCR_SPO2);
    zassert_equal(hpi_disp_get_curr_screen(), SCR_SPO2, "Should set and get SPO2 screen");
    
    hpi_disp_set_curr_screen(SCR_HOME);
    zassert_equal(hpi_disp_get_curr_screen(), SCR_HOME, "Should set and get HOME screen");
}

ZTEST(smf_display_core, test_screen_management_boundaries)
{
    // Test boundary values
    hpi_disp_set_curr_screen(SCR_LIST_START);
    zassert_equal(hpi_disp_get_curr_screen(), SCR_LIST_START, "Should handle start boundary");
    
    hpi_disp_set_curr_screen(SCR_LIST_END - 1);
    zassert_equal(hpi_disp_get_curr_screen(), SCR_LIST_END - 1, "Should handle end boundary");
}

ZTEST(smf_display_core, test_state_persistence_save_restore)
{
    // Set initial screen
    hpi_disp_set_curr_screen(SCR_TEMP);
    
    // Save state
    hpi_disp_save_screen_state();
    zassert_true(screen_sleep_state.state_saved, "State should be marked as saved");
    zassert_equal(screen_sleep_state.saved_screen, SCR_TEMP, "Saved screen should be TEMP");
    
    // Change current screen
    hpi_disp_set_curr_screen(SCR_ECG);
    zassert_equal(hpi_disp_get_curr_screen(), SCR_ECG, "Current screen should be ECG");
    
    // Restore state
    hpi_disp_restore_screen_state();
    zassert_equal(hpi_disp_get_curr_screen(), SCR_TEMP, "Screen should be restored to TEMP");
}

ZTEST(smf_display_core, test_state_persistence_clear)
{
    // Save some state
    hpi_disp_set_curr_screen(SCR_BPT);
    hpi_disp_save_screen_state();
    zassert_true(screen_sleep_state.state_saved, "State should be saved");
    
    // Clear state
    hpi_disp_clear_saved_state();
    zassert_false(screen_sleep_state.state_saved, "State should be cleared");
    zassert_equal(screen_sleep_state.saved_screen, SCR_HOME, "Saved screen should reset to HOME");
}

ZTEST(smf_display_core, test_state_persistence_no_saved_state)
{
    // Clear any saved state
    hpi_disp_clear_saved_state();
    
    // Set current screen
    hpi_disp_set_curr_screen(SCR_TODAY);
    
    // Try to restore with no saved state
    hpi_disp_restore_screen_state();
    
    // Current screen should remain unchanged
    zassert_equal(hpi_disp_get_curr_screen(), SCR_TODAY, "Screen should remain unchanged");
}

ZTEST(smf_display_core, test_calorie_calculation_zero_steps)
{
    uint16_t kcals = hpi_get_kcals_from_steps(0);
    zassert_equal(kcals, 0, "Zero steps should result in zero calories");
}

ZTEST(smf_display_core, test_calorie_calculation_basic)
{
    uint16_t kcals_1000 = hpi_get_kcals_from_steps(1000);
    zassert_true(kcals_1000 > 0, "1000 steps should result in some calories");
    zassert_true(kcals_1000 < 100, "1000 steps should result in reasonable calories");
    
    uint16_t kcals_2000 = hpi_get_kcals_from_steps(2000);
    zassert_true(kcals_2000 > kcals_1000, "2000 steps should burn more calories than 1000");
}

ZTEST(smf_display_core, test_calorie_calculation_proportional)
{
    uint16_t kcals_2000 = hpi_get_kcals_from_steps(2000);
    uint16_t kcals_4000 = hpi_get_kcals_from_steps(4000);
    
    // 4000 steps should be approximately twice the calories of 2000 steps
    float ratio = (float)kcals_4000 / (float)kcals_2000;
    zassert_true(ratio > 1.8f && ratio < 2.2f, "Calorie calculation should be roughly proportional");
}

ZTEST(smf_display_core, test_calorie_calculation_large_values)
{
    uint16_t kcals = hpi_get_kcals_from_steps(30000);
    zassert_true(kcals > 0, "Large step count should result in calories");
    zassert_true(kcals < 2000, "Large step count should still result in reasonable calories");
}

ZTEST(smf_display_core, test_message_queue_ecg_basic)
{
    struct hpi_ecg_bioz_sensor_data_t test_data = {
        .ecg_samples = {100, 101, 102, 103, 104},
        .ecg_num_samples = 5,
        .ecg_lead_off = false,
        .bioz_sample = 1000,
        .bioz_num_samples = 1,
        .bioz_lead_off = false
    };
    
    // Test put operation
    int ret = test_msgq_put(&q_plot_ecg_bioz, &test_data);
    zassert_equal(ret, 0, "Should successfully put ECG data");
    
    // Test get operation
    struct hpi_ecg_bioz_sensor_data_t received_data;
    ret = test_msgq_get(&q_plot_ecg_bioz, &received_data);
    zassert_equal(ret, 0, "Should successfully get ECG data");
    
    // Verify data integrity
    zassert_equal(received_data.ecg_num_samples, 5, "ECG sample count should match");
    zassert_false(received_data.ecg_lead_off, "ECG lead status should match");
    zassert_equal(received_data.ecg_samples[0], 100, "First ECG sample should match");
    zassert_equal(received_data.ecg_samples[4], 104, "Last ECG sample should match");
}

ZTEST(smf_display_core, test_message_queue_ppg_basic)
{
    struct hpi_ppg_wr_data_t test_data = {
        .hr = 72,
        .spo2 = 99,
        .spo2_state = 2,
        .spo2_valid_percent_complete = 95,
        .ppg_samples = {2000, 2001, 2002, 2003},
        .ppg_num_samples = 4
    };
    
    // Test put and get
    int ret = test_msgq_put(&q_plot_ppg_wrist, &test_data);
    zassert_equal(ret, 0, "Should successfully put PPG data");
    
    struct hpi_ppg_wr_data_t received_data;
    ret = test_msgq_get(&q_plot_ppg_wrist, &received_data);
    zassert_equal(ret, 0, "Should successfully get PPG data");
    
    // Verify data
    zassert_equal(received_data.hr, 72, "HR should match");
    zassert_equal(received_data.spo2, 99, "SpO2 should match");
    zassert_equal(received_data.spo2_valid_percent_complete, 95, "SpO2 progress should match");
}

ZTEST(smf_display_core, test_message_queue_boot_msg)
{
    struct hpi_boot_msg_t test_msg = {
        .status = true,
        .show_status = true
    };
    strncpy(test_msg.msg, "Boot Test Message", sizeof(test_msg.msg) - 1);
    test_msg.msg[sizeof(test_msg.msg) - 1] = '\0';
    
    // Test message handling
    int ret = test_msgq_put(&q_disp_boot_msg, &test_msg);
    zassert_equal(ret, 0, "Should successfully put boot message");
    
    struct hpi_boot_msg_t received_msg;
    ret = test_msgq_get(&q_disp_boot_msg, &received_msg);
    zassert_equal(ret, 0, "Should successfully get boot message");
    
    // Verify message
    zassert_true(received_msg.status, "Boot status should be true");
    zassert_true(received_msg.show_status, "Show status should be true");
    zassert_equal(strcmp(received_msg.msg, "Boot Test Message"), 0, "Message text should match");
}

ZTEST(smf_display_core, test_message_queue_overflow)
{
    struct hpi_boot_msg_t test_msg = {
        .status = false,
        .show_status = false
    };
    strncpy(test_msg.msg, "Overflow", sizeof(test_msg.msg) - 1);
    
    // Fill queue to capacity (4 messages max)
    for (int i = 0; i < 4; i++) {
        int ret = test_msgq_put(&q_disp_boot_msg, &test_msg);
        zassert_equal(ret, 0, "Should put message %d", i);
    }
    
    // Try to overflow
    int ret = test_msgq_put(&q_disp_boot_msg, &test_msg);
    zassert_equal(ret, -1, "Should fail to put when queue is full");
}

ZTEST(smf_display_core, test_message_queue_empty)
{
    // Ensure queue is empty
    test_msgq_reset(&q_disp_boot_msg);
    
    // Try to get from empty queue
    struct hpi_boot_msg_t received_msg;
    int ret = test_msgq_get(&q_disp_boot_msg, &received_msg);
    zassert_equal(ret, -1, "Should fail to get from empty queue");
}

ZTEST(smf_display_core, test_hardware_battery_status)
{
    // Test normal battery
    mock_low_battery = false;
    zassert_false(hw_is_low_battery(), "Should report normal battery");
    
    // Test low battery
    mock_low_battery = true;
    zassert_true(hw_is_low_battery(), "Should report low battery");
}

ZTEST(smf_display_core, test_inactivity_timer)
{
    // Test initial state
    mock_inactivity_time = 0;
    zassert_equal(lv_disp_get_inactive_time(NULL), 0, "Initial inactivity should be 0");
    
    // Test setting inactivity
    mock_inactivity_time = 7500;
    zassert_equal(lv_disp_get_inactive_time(NULL), 7500, "Inactivity should be set value");
    
    // Test activity trigger
    lv_disp_trig_activity(NULL);
    zassert_equal(lv_disp_get_inactive_time(NULL), 0, "Activity should reset timer");
}

ZTEST(smf_display_core, test_sleep_conditions)
{
    // Test normal operation - should not sleep
    mock_low_battery = false;
    mock_inactivity_time = 5000; // Less than threshold
    zassert_false(should_enter_sleep(), "Should not sleep with low inactivity");
    
    // Test high inactivity - should sleep
    mock_inactivity_time = DISP_SLEEP_TIME_MS + 1000;
    zassert_true(should_enter_sleep(), "Should sleep with high inactivity");
    
    // Test low battery - should not sleep even with high inactivity
    mock_low_battery = true;
    zassert_false(should_enter_sleep(), "Should not sleep with low battery");
}

ZTEST(smf_display_core, test_reset_functionality)
{
    int result = hpi_disp_reset_all_last_updated();
    zassert_equal(result, 0, "Reset function should succeed");
}

ZTEST(smf_display_core, test_data_structure_integrity)
{
    // Test that our data structures have reasonable sizes
    size_t ecg_size = sizeof(struct hpi_ecg_bioz_sensor_data_t);
    size_t ppg_size = sizeof(struct hpi_ppg_wr_data_t);
    size_t boot_size = sizeof(struct hpi_boot_msg_t);
    
    zassert_true(ecg_size > 0 && ecg_size < 1024, "ECG data structure should have reasonable size");
    zassert_true(ppg_size > 0 && ppg_size < 1024, "PPG data structure should have reasonable size");
    zassert_true(boot_size > 0 && boot_size < 1024, "Boot message should have reasonable size");
}

/* Test suite definition */
ZTEST_SUITE(smf_display_core, NULL, setup, NULL, NULL, teardown);
```
